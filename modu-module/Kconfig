## modu-module/boards/minewsemi/ms88sf3/Kconfig.ms88sf3
```kconfig
# Copyright (c) 2026 The Modu Contributors
# SPDX-License-Identifier: MIT

config BOARD_MS88SF3
    select SOC_NRF52840_QIAA
```

## modu-module/boards/shields/modu/Kconfig.defconfig
```kconfig
# Copyright (c) 2026 The Modu Contributors
# SPDX-License-Identifier: MIT

if SHIELD_MODU_LEFT

config ZMK_KEYBOARD_NAME
    default "Modu"

config ZMK_SPLIT_ROLE_CENTRAL
    default y

endif

if SHIELD_MODU_LEFT || SHIELD_MODU_RIGHT

config ZMK_SPLIT
    default y

endif
```

## modu-module/boards/shields/modu/Kconfig.shield
```kconfig
# Copyright (c) 2026 The Modu Contributors
# SPDX-License-Identifier: MIT

config SHIELD_MODU_LEFT
    def_bool $(shields_list_contains,modu_left)

config SHIELD_MODU_RIGHT
    def_bool $(shields_list_contains,modu_right)
```
